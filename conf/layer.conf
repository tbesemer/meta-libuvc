## conf/layer.conf
```bitbake
BBPATH .= ":${LAYERDIR}"

BBFILES += "${LAYERDIR}/recipes-*/*/*.bb \
        ${LAYERDIR}/recipes-*/*/*.bbappend"

BBFILE_COLLECTIONS += "meta-libuvc"
BBFILE_PATTERN_meta-libuvc = "^${LAYERDIR}/"
BBFILE_PRIORITY_meta-libuvc = "50"

LAYERVERSION_meta-libuvc = "1"
```
